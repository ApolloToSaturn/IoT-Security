## SSD1306/lvgl/Kconfig/arch/Kconfig
```kconfig
# Load Zephyr Arch Kconfig descriptions.
osource "E:/Uni/WS2425/IoT_Security/NRF/v2.8.0/zephyr/arch/x86/Kconfig"
osource "E:/Uni/WS2425/IoT_Security/NRF/v2.8.0/zephyr/arch/xtensa/Kconfig"
osource "E:/Uni/WS2425/IoT_Security/NRF/v2.8.0/zephyr/arch/sparc/Kconfig"
osource "E:/Uni/WS2425/IoT_Security/NRF/v2.8.0/zephyr/arch/riscv/Kconfig"
osource "E:/Uni/WS2425/IoT_Security/NRF/v2.8.0/zephyr/arch/posix/Kconfig"
osource "E:/Uni/WS2425/IoT_Security/NRF/v2.8.0/zephyr/arch/nios2/Kconfig"
osource "E:/Uni/WS2425/IoT_Security/NRF/v2.8.0/zephyr/arch/mips/Kconfig"
osource "E:/Uni/WS2425/IoT_Security/NRF/v2.8.0/zephyr/arch/arm64/Kconfig"
osource "E:/Uni/WS2425/IoT_Security/NRF/v2.8.0/zephyr/arch/arm/Kconfig"
osource "E:/Uni/WS2425/IoT_Security/NRF/v2.8.0/zephyr/arch/arc/Kconfig"
```

## SSD1306/lvgl/SSD1306/Kconfig/Kconfig.shield.defconfig
```kconfig
osource "E:/Uni/WS2425/IoT_Security/NRF/v2.8.0/nrf/boards/shields/*/Kconfig.defconfig"
```

## SSD1306/lvgl/SSD1306/Kconfig/boards/Kconfig
```kconfig
# Load Zephyr board Kconfig descriptions.
osource "E:/Uni/WS2425/IoT_Security/NRF/v2.8.0/zephyr/boards/nordic/nrf9160dk/Kconfig"
```

## test/Kconfig/Kconfig.shield.defconfig
```kconfig
osource "E:/Uni/WS2425/IoT_Security/NRF/v2.7.0/nrf/boards/shields/*/Kconfig.defconfig"
```
