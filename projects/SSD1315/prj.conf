## CMakeLists.txt
```
cmake_minimum_required(VERSION 3.20.0)
find_package(Zephyr REQUIRED HINTS $ENV{ZEPHYR_BASE})
project(ssd1315_display)

target_sources(app PRIVATE
    src/main.c
    drivers/ssd1315/ssd1315.c
    drivers/ssd1315/ssd1315_reg.c
    drivers/ssd1315/i2c_helper.c


    ../i2c_scanner/src/i2c_scanner.c
)

# Füge den neuen include-Pfad hinzu
target_include_directories(app PRIVATE
    ${CMAKE_CURRENT_SOURCE_DIR}/include
    ${CMAKE_CURRENT_SOURCE_DIR}/include/ssd1315

    ${CMAKE_CURRENT_SOURCE_DIR}/../i2c_scanner/include
)
```

## prj.conf
```kconfig
# Aktivieren des I2C-Treibers
CONFIG_I2C=y

# Aktivieren des Display-Subsystems
CONFIG_DISPLAY=y

# Log-Ausgabe aktivieren (optional, für Debugging)
CONFIG_LOG=y
CONFIG_LOG_DEFAULT_LEVEL=3

CONFIG_MAIN_STACK_SIZE=16384
CONFIG_SYSTEM_WORKQUEUE_STACK_SIZE=16384
CONFIG_HEAP_MEM_POOL_SIZE=32768
```

## src/main.c
```c
#include <zephyr/kernel.h>
#include <zephyr/device.h>
#include <zephyr/logging/log.h>
#include <zephyr/drivers/i2c.h>
#include <string.h>

// Imports für Display
#include "i2c_scanner.h"
#include "ssd1315.h"
#include "i2c_helper.h"

#include "draw.h"

LOG_MODULE_REGISTER(main, LOG_LEVEL_INF);

// SSD1315-Objekt und IO-Struktur
SSD1315_Object_t ssd1315_obj;
SSD1315_IO_t ssd1315_io = {
    .Init = I2C_Init,
    .DeInit = I2C_DeInit,
    .WriteReg = I2C_WriteReg,
    .ReadReg = I2C_ReadReg,
    .GetTick = (int32_t (*)(void))k_uptime_get_32 // Zephyr-Zeitfunktion
};

int init_display(void) {
    LOG_INF("Initializing SSD1315");
    if (SSD1315_RegisterBusIO(&ssd1315_obj, &ssd1315_io) != SSD1315_OK) {
        LOG_ERR("Failed to register SSD1315 IO");
        return -1;
    }
    if (SSD1315_Init(&ssd1315_obj, SSD1315_FORMAT_DEFAULT, SSD1315_ORIENTATION_LANDSCAPE) != SSD1315_OK) {
        LOG_ERR("Failed to initialize SSD1315");
        return -1;
    }
    LOG_INF("SSD1315 initialized successfully");
    return 0;
}



int main(void) {
    LOG_INF("Starting SSD1315 application");
    i2c_scan();
    init_display();

    SSD1315_DisplayOn(&ssd1315_obj);

    draw_chess_pattern(&ssd1315_obj);
    k_sleep(K_SECONDS(2));

    draw_random_pattern(&ssd1315_obj);
    k_sleep(K_SECONDS(2));

    draw_hbrs_logo(&ssd1315_obj);
    k_sleep(K_SECONDS(2));

    LOG_INF("Ending SSD1315 application");
    return 0;
}
```

## include/draw.h
```c
// draw.h
#ifndef DRAW_H
#define DRAW_H

#include "ssd1315.h"

void draw_chess_pattern(SSD1315_Object_t *obj);
void draw_random_pattern(SSD1315_Object_t *obj);
void draw_hbrs_logo(SSD1315_Object_t *obj);

#endif // DRAW_H
```

## include/hbrs_logo.h
```c
#ifndef SSD1315_LOGO_H
#define SSD1315_LOGO_H

#include "ssd1315.h"

// Logo-Daten (z. B. 16x16 Pixel, anpassen nach Bedarf)
static const uint8_t hbrs_logo_map[] = {
    0x00, 0x3C, 0x7E, 0xE7, 0xC3, 0xC3, 0xE7, 0x7E,
    0x3C, 0x00, 0x00, 0x00, 0x18, 0x3C, 0x7E, 0xFF,
    0xFF, 0x7E, 0x3C, 0x18, 0x00, 0x00, 0x00, 0x00,
    0x00, 0x00, 0xFF, 0xFF, 0x00, 0x00, 0x00, 0x00
};

// Funktion zum Zeichnen des Logos
static inline void SSD1315_DrawLogo(SSD1315_Object_t *pObj, uint8_t x, uint8_t y, uint8_t color) {
    uint8_t width = 16;  // Breite des Logos
    uint8_t height = 16; // Höhe des Logos

    for (uint8_t row = 0; row < height; row++) {
        uint8_t line = hbrs_logo_map[row];
        for (uint8_t col = 0; col < width; col++) {
            if (line & (1 << (width - 1 - col))) { // Prüfe Pixel in der Bitmap
                SSD1315_SetPixel(pObj, x + col, y + row, color);
            } else {
                SSD1315_SetPixel(pObj, x + col, y + row, !color);
            }
        }
    }
}

#endif // SSD1315_LOGO_H
```

## include/hbrs_logo_bitmap.h
```c
#ifndef HBRS_LOGO_BITMAP_H
#define HBRS_LOGO_BITMAP_H

#define LOGO_WIDTH 128
#define LOGO_HEIGHT 64

const uint8_t hbrs_logo_bitmap[] = {
    0x00, 0x00, 0x00, 0x00, 0x00, 0x00, 0x00, 0x00, 0x00, 0x00, 0x00, 0x00, 0x00, 0x00, 0x00, 0x00, 0x00, 0x00, 0x00, 0x00, 0x00, 0x00, 0x00, 0x00, 0x00, 0x00, 0x00, 0x00, 0x00, 0x00, 0x00, 0x00, 0x00, 0x00, 0x00, 0x00, 0x00, 0x00, 0x00, 0x00, 0x00, 0x00, 0x00, 0x00, 0x00, 0x00, 0x00, 0x00, 0x00, 0x00, 0x00, 0x00, 0x00, 0x00, 0x00, 0x00, 0x00, 0x00, 0x00, 0x00, 0x00, 0x00, 0x00, 0x00, 0x00, 0x00, 0x00, 0x00, 0x00, 0x00, 0x00, 0x00, 0x00, 0x00, 0x00, 0x00, 0x00, 0x00, 0x00, 0x00, 0x00, 0x00, 0x00, 0x00, 0x00, 0x00, 0x00, 0x00, 0x00, 0x00, 0x00, 0x00, 0x00, 0x00, 0x00, 0x00, 0x00, 0x00, 0x00, 0x00, 0x00, 0x00, 0x00, 0x00, 0x00, 0x00, 0x00, 0x00, 0x00, 0x00, 0x00, 0x00, 0x00, 0x00, 0x00, 0x00, 0x00, 0x00, 0x00, 0x00, 0x00, 0x00, 0x00, 0x00, 0x00, 0x00, 0x00, 0x00, 0x00, 0x00, 0x00, 0x00, 0x00, 0x00, 0x00, 0x00, 0x00, 0x00, 0x00, 0x00, 0x00, 0x00, 0x00, 0x00, 0x00, 0x00, 0x00, 0x00, 0x00, 0x00, 0x00, 0x00, 0x00, 0x00, 0x00, 0x00, 0x00, 0x00, 0x00, 0x00, 0x00, 0x00, 0x00, 0x00, 0x00, 0x00, 0x00, 0x00, 0x00, 0x00, 0x00, 0x00, 0x00, 0x00, 0x00, 0x00, 0x00, 0x00, 0x00, 0x00, 0x00, 0x00, 0x00, 0x00, 0x00, 0x00, 0x00, 0x00, 0x00, 0x00, 0x00, 0x00, 0x00, 0x00, 0x00, 0x00, 0x00, 0x00, 0x00, 0x00, 0x00, 0x00, 0x00, 0x00, 0x00, 0x00, 0x00, 0x00, 0x00, 0x00, 0x00, 0x00, 0x00, 0x00, 0x00, 0x00, 0x00, 0x00, 0x00, 0x00, 0x00, 0x00, 0x00, 0x00, 0x00, 0x00, 0x00, 0x00, 0x00, 0x00, 0x00, 0x00, 0x00, 0x00, 0x00, 0x00, 0x00, 0x00, 0x00, 0x00, 0x00, 0x00, 0x00, 0x00, 0x00, 0x00, 0x00, 0x00, 0x00, 0x00, 0x00, 0x00, 0x00, 0x00, 0x00, 0x00, 0x00, 0x00, 0x00, 0x00, 0x00, 0x00, 0x00, 0x00, 0x00, 0x00, 0x00, 0x00, 0x00, 0x00, 0x00, 0x00, 0x00, 0x00, 0x00, 0x00, 0x00, 0x00, 0x00, 0x00, 0x00, 0x00, 0x80, 0x00, 0x80, 0x00, 0x40, 0x80, 0x00, 0x40, 0x80, 0x40, 0x00, 0x40, 0x80, 0x40, 0x80, 0x00, 0x40, 0x80, 0x00, 0x80, 0x00, 0x00, 0x00, 0x00, 0x00, 0x00, 0x00, 0x00, 0x00, 0x00, 0x00, 0x00, 0x00, 0x00, 0x00, 0x00, 0x00, 0x00, 0x00, 0x00, 0x00, 0x00, 0x00, 0x00, 0x00, 0x00, 0x00, 0x00, 0x00, 0x00, 0x00, 0x00, 0x00, 0x00, 0x00, 0x00, 0x80, 0x00, 0x80, 0x00, 0x80, 0x40, 0x00, 0x40, 0x80, 0x40, 0x00, 0x40, 0x80, 0x40, 0x80, 0x00, 0x40, 0x80, 0x00, 0x80, 0x00, 0x00, 0x00, 0x00, 0x00, 0x00, 0x00, 0x00, 0x00, 0x00, 0x00, 0x00, 0x00, 0x00, 0x00, 0x00, 0x00, 0x00, 0x00, 0x00, 0x00, 0x00, 0x00, 0x00, 0x00, 0x00, 0x00, 0x00, 0x00, 0x00, 0x00, 0x00, 0x00, 0x00, 0x00, 0x00, 0x00, 0x00, 0x00, 0x00, 0x00, 0x00, 0x80, 0x20, 0x50, 0x88, 0x54, 0x22, 0x48, 0x95, 0x24, 0x09, 0x02, 0x04, 0x01, 0x02, 0x01, 0x00, 0x01, 0x02, 0x00, 0x01, 0x02, 0x01, 0x00, 0x02, 0x00, 0x01, 0x02, 0x04, 0x02, 0x08, 0x03, 0x0C, 0x51, 0xAA, 0x04, 0x68, 0x94, 0x40, 0x30, 0x80, 0x00, 0x00, 0x00, 0x00, 0x00, 0x00, 0x00, 0x00, 0x00, 0x00, 0x00, 0x00, 0x00, 0x00, 0x00, 0x00, 0x00, 0xC0, 0x10, 0x68, 0x84, 0x30, 0x46, 0x28, 0x55, 0x82, 0x34, 0x49, 0x92, 0x24, 0xCA, 0x11, 0x6A, 0x85, 0x28, 0x52, 0x25, 0x52, 0x84, 0x3A, 0x40, 0x97, 0x48, 0x12, 0x65, 0x88, 0x55, 0x22, 0x99, 0x42, 0x14, 0xEA, 0x00, 0x58, 0x20, 0xC0, 0x00, 0x00, 0x00, 0x00, 0x00, 0x00, 0x00, 0x00, 0x00, 0x00, 0x00, 0x00, 0x00, 0x00, 0x00, 0x00, 0x00, 0x00, 0x00, 0x00, 0x00, 0x00, 0x00, 0x00, 0x00, 0x00, 0x00, 0x00, 0x00, 0x00, 0x00, 0x00, 0x00, 0x05, 0x02, 0x0C, 0x11, 0x2A, 0x45, 0x28, 0xA4, 0x48, 0x10, 0x60, 0x80, 0x60, 0x00, 0xA0, 0x40, 0x00, 0xC0, 0x00, 0x40, 0x40, 0x80, 0x40, 0x20, 0x80, 0x20, 0xC0, 0x10, 0xA0, 0x48, 0x94, 0x22, 0x55, 0x08, 0x25, 0x12, 0x04, 0x09, 0x02, 0x00, 0x00, 0x00, 0x00, 0x00, 0x00, 0x00, 0x00, 0x00, 0x00, 0x00, 0x00, 0x00, 0x00, 0x00, 0x00, 0x00, 0x02, 0x09, 0x12, 0x0C, 0x21, 0x4A, 0x15, 0xC8, 0x13, 0x64, 0x89, 0x32, 0x44, 0x9A, 0x21, 0x4A, 0x94, 0x29, 0x42, 0xAD, 0x10, 0xCB, 0x14, 0xA1, 0x54, 0x23, 0x4C, 0x91, 0x64, 0x09, 0x56, 0x20, 0x4B, 0x14, 0x22, 0x15, 0x08, 0x03, 0x04, 0x00, 0x00, 0x00, 0x00, 0x00, 0x00, 0x00, 0x00, 0x00, 0x00, 0x00, 0x00, 0x00, 0x00, 0x00, 0x00, 0x00, 0x00, 0x00, 0x00, 0x00, 0x00, 0x00, 0x00, 0x00, 0x00, 0x00, 0x00, 0x00, 0x00, 0x00, 0x00, 0x00, 0x00, 0x00, 0x00, 0x00, 0x00, 0x00, 0x00, 0x00, 0x00, 0x01, 0x00, 0x00, 0x01, 0x00, 0x00, 0x01, 0x02, 0x00, 0x01, 0x02, 0x01, 0x00, 0x01, 0x00, 0x01, 0x00, 0x00, 0x01, 0x00, 0x00, 0x00, 0x00, 0x00, 0x00, 0x00, 0x00, 0x00, 0x00, 0x00, 0x00, 0x00, 0x00, 0x00, 0x00, 0x00, 0x00, 0x00, 0x00, 0x00, 0x00, 0x00, 0x00, 0x00, 0x00, 0x00, 0x00, 0x00, 0x00, 0x00, 0x00, 0x00, 0x00, 0x00, 0x00, 0x00, 0x00, 0x00, 0x01, 0x00, 0x00, 0x01, 0x00, 0x01, 0x00, 0x01, 0x02, 0x00, 0x02, 0x01, 0x00, 0x00, 0x01, 0x00, 0x00, 0x01, 0x00, 0x00, 0x00, 0x00, 0x00, 0x00, 0x00, 0x00, 0x00, 0x00, 0x00, 0x00, 0x00, 0x00, 0x00, 0x00, 0x00, 0x00, 0x00, 0x00, 0x00, 0x00, 0x00, 0x00, 0x00, 0x00, 0x00, 0x00, 0x00, 0x00, 0x00, 0x00, 0x00, 0x00, 0x00, 0x00, 0x00, 0x00, 0x00, 0x00, 0x00, 0x00, 0x00, 0x00, 0x00, 0x00, 0x00, 0x00, 0x00, 0x00, 0x00, 0x00, 0x00, 0x00, 0x00, 0x00, 0x00, 0x00, 0x00, 0x00, 0x00, 0x00, 0x00, 0x00, 0x00, 0x00, 0x00, 0x00, 0x00, 0x00, 0x00, 0x00, 0x00, 0x00, 0x00, 0x00, 0x00, 0x00, 0x00, 0x00, 0x00, 0x00, 0x00, 0x00, 0x00, 0x00, 0x00, 0x00, 0x00, 0x00, 0x00, 0x00, 0x00, 0x00, 0x00, 0x00, 0x00, 0x00, 0x00, 0x00, 0x00, 0x00, 0x00, 0x00, 0x00, 0x00, 0x00, 0x00, 0x00, 0x00, 0x00, 0x00, 0x00, 0x00, 0x00, 0x00, 0x00, 0x00, 0x00, 0x00, 0x00, 0x00, 0x00, 0x00, 0x00, 0x00, 0x00, 0x00, 0x00, 0x00, 0x00, 0x00, 0x00, 0x00, 0x00, 0x00, 0x00, 0x00, 0x00, 0x00, 0x00, 0x00, 0x00, 0x00, 0x00, 0x00, 0x00, 0x00, 0x00, 0x00, 0x00, 0x00, 0x00, 0x00, 0x00, 0x00, 0x00, 0x00, 0x00, 0x00, 0x00, 0x00, 0x00, 0x00, 0x00, 0x00, 0x00, 0x00, 0x00, 0x00, 0x00, 0x00, 0x00, 0x00, 0x00, 0x00, 0x00, 0x00, 0x00, 0x00, 0x00, 0x00, 0x00, 0x00, 0x00, 0x00, 0x00, 0x00, 0x00, 0x00, 0x00, 0x00, 0x00, 0x00, 0x00, 0x00, 0x00, 0x00, 0x00, 0x00, 0x00, 0x00, 0x00, 0x00, 0x00, 0x00, 0x00, 0x00, 0x00, 0x00, 0x00, 0x00, 0x00, 0x00, 0x00, 0x00, 0x00, 0x00, 0x00, 0x00, 0x00, 0x00, 0x00, 0x00, 0x00, 0x00, 0x00, 0x00, 0x00, 0x00, 0x00, 0x00, 0x00, 0x00, 0x00, 0x00, 0x00, 0x00, 0x00, 0x00, 0x00, 0x00, 0x00, 0x00, 0x00, 0x00, 0x00, 0x00, 0x00, 0x00, 0x00, 0x00, 0x00, 0x00, 0x00, 0x00, 0x00, 0x00, 0x00, 0x00, 0x00, 0x00, 0x00, 0x00, 0x00, 0x00, 0x00, 0x00, 0x00, 0x00, 0x00, 0x00, 0x00, 0x00, 0x00, 0x00, 0x00, 0x00, 0x00, 0x00, 0x00, 0x00
};

#endif /* HBRS_LOGO_BITMAP_H */
```

## src/draw.c
```c
#include <zephyr/logging/log.h>
#include "ssd1315.h"
#include "hbrslogo.h"

LOG_MODULE_REGISTER(draw, LOG_LEVEL_INF);

void draw_chess_pattern(SSD1315_Object_t *obj) {
    LOG_INF("Chess Pattern");
    SSD1315_Clear(obj, SSD1315_COLOR_BLACK);
    for (uint32_t y = 0; y < 64; y += 8) {
        for (uint32_t x = 0; x < 128; x += 8) {
            SSD1315_FillRect(obj, x, y, 8, 8, (x + y) % 16 == 0 ? SSD1315_COLOR_WHITE : SSD1315_COLOR_BLACK);
        }
    }
    SSD1315_Refresh(obj);
}

void draw_random_pattern(SSD1315_Object_t *obj) {
    LOG_INF("Random Pattern");
    SSD1315_Clear(obj, SSD1315_COLOR_BLACK);
    for (uint32_t y = 0; y < SSD1315_LCD_PIXEL_HEIGHT; y++) {
        for (uint32_t x = 0; x < SSD1315_LCD_PIXEL_WIDTH; x++) {
            SSD1315_SetPixel(obj, x, y, (x + y) % 4 ? SSD1315_COLOR_WHITE : SSD1315_COLOR_BLACK);
        }
    }
    SSD1315_Refresh(obj);
}

void draw_hbrs_logo(SSD1315_Object_t *obj) {
    LOG_INF("HBRS Logo");
    SSD1315_Clear(obj, SSD1315_COLOR_BLACK);
    SSD1315_DrawBitmap(obj, 0, 0, hbrslogo_bits);
    SSD1315_Refresh(obj);
}
```
