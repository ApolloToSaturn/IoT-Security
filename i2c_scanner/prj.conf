## CMakeLists.txt
```
cmake_minimum_required(VERSION 3.20.0)
find_package(Zephyr REQUIRED HINTS $ENV{ZEPHYR_BASE})
project(i2c_scanner)

target_sources(app PRIVATE src/main.c src/i2c_scanner.c)

target_include_directories(app PRIVATE
    ${CMAKE_CURRENT_SOURCE_DIR}/include
)
```

## prj.conf
```kconfig
CONFIG_I2C=y
CONFIG_LOG=y
CONFIG_LOG_DEFAULT_LEVEL=3
```

## src/main.c
```c
#include <zephyr/device.h>
#include <zephyr/drivers/i2c.h>
#include <zephyr/kernel.h>
#include <zephyr/logging/log.h>

#include "i2c_scanner.h"

LOG_MODULE_REGISTER(main);

int main(void) {
    i2c_scan();
    return 0;
}
```

## include/i2c_scanner.h
```c
#ifndef I2C_SCANNER_H
#define I2C_SCANNER_H

#include <zephyr/kernel.h>
#include <zephyr/device.h>
#include <zephyr/drivers/i2c.h>

// Deklaration der Funktion
void i2c_scan(void);

#endif // I2C_SCANNER_H
```
